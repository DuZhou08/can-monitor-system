#include "tft.h"

/* ================= 6x8 ASCII 字库 (0x20 ~ 0x7E) ================= */
static const uint8_t font_F8x16[][16] = {
	0x00,0x00,0x00,0x00,0x00,0x00,0x00,0x00,
	0x00,0x00,0x00,0x00,0x00,0x00,0x00,0x00,//  0
	
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	0x00,0x00,0x00,0x00,0x00,0x00,0x00,0x00,//~ 94
};

/* ================= 内部函数 ================= */

static void TFT_DWT_Init(void)
{
	CoreDebug->DEMCR |= CoreDebug_DEMCR_TRCENA_Msk;
	DWT->CYCCNT = 0;
	DWT->CTRL |= DWT_CTRL_CYCCNTENA_Msk;
}

static void TFT_DelayUs(uint32_t us)
{
	DWT->CYCCNT = 0;
	while (DWT->CYCCNT < us * 168)   /* 168MHz -> 1us = 168 个周期 */
	{
	}
}

static void TFT_DelayMs(uint32_t ms)
{
	while (ms--)
	{
		TFT_DelayUs(1000);
	}
}

static void TFT_SPI_WriteByte(uint8_t byte)
{
	while (SPI_I2S_GetFlagStatus(TFT_SPI, SPI_I2S_FLAG_TXE) == RESET)
	{
	}
	SPI_I2S_SendData(TFT_SPI, byte);
	while (SPI_I2S_GetFlagStatus(TFT_SPI, SPI_I2S_FLAG_BSY) == SET)
	{
	}
}

static void TFT_WriteCmd(uint8_t cmd)
{
	TFT_DC_L();
	TFT_CS_L();
	TFT_SPI_WriteByte(cmd);
	TFT_CS_H();
}

static void TFT_WriteData8(uint8_t data)
{
	TFT_DC_H();
	TFT_CS_L();
	TFT_SPI_WriteByte(data);
	TFT_CS_H();
}

/* 写寄存器: 先命令, 后 len 个数据字节 */
static void TFT_WriteReg(uint8_t reg, const uint8_t *data, uint8_t len)
{
	TFT_DC_L();
	TFT_CS_L();
	TFT_SPI_WriteByte(reg);
	TFT_DC_H();
	while (len--)
	{
		TFT_SPI_WriteByte(*data++);
	}
	TFT_CS_H();
}

/* ================= 初始化 ================= */

void TFT_Init(void)
{
	const uint8_t gamma_pos[] = {0x00,0x03,0x09,0x08,0x16,0x0A,0x3F,0x78,0x4C,0x0C,0x0A,0x08,0x16,0x1A,0x0F};
	const uint8_t gamma_neg[] = {0x00,0x16,0x19,0x03,0x0F,0x05,0x32,0x45,0x46,0x04,0x0E,0x0D,0x35,0x37,0x0F};

	RCC_AHB1PeriphClockCmd(RCC_AHB1Periph_GPIOB | RCC_AHB1Periph_GPIOC, ENABLE);
	RCC_APB1PeriphClockCmd(TFT_SPI_RCC, ENABLE);

	/* SCK / MOSI / MISO 复用为 SPI2 (PB13/15/14) */
	GPIO_InitTypeDef GPIO_InitStructure;
	GPIO_InitStructure.GPIO_Pin = TFT_SCK_PIN | TFT_MOSI_PIN | TFT_MISO_PIN;
	GPIO_InitStructure.GPIO_Mode = GPIO_Mode_AF;
	GPIO_InitStructure.GPIO_OType = GPIO_OType_PP;
	GPIO_InitStructure.GPIO_PuPd = GPIO_PuPd_NOPULL;
	GPIO_InitStructure.GPIO_Speed = GPIO_Speed_50MHz;
	GPIO_Init(GPIOB, &GPIO_InitStructure);
	GPIO_PinAFConfig(GPIOB, TFT_SCK_SRC, GPIO_AF_SPI2);
	GPIO_PinAFConfig(GPIOB, TFT_MOSI_SRC, GPIO_AF_SPI2);
	GPIO_PinAFConfig(GPIOB, TFT_MISO_SRC, GPIO_AF_SPI2);

	/* CS / DC / BKL 推挽输出 */
	GPIO_InitStructure.GPIO_Pin = TFT_CS_PIN;
	GPIO_InitStructure.GPIO_Mode = GPIO_Mode_OUT;
	
	GPIO_InitStructure.GPIO_OType = GPIO_OType_PP;
	GPIO_InitStructure.GPIO_PuPd = GPIO_PuPd_NOPULL;
	GPIO_InitStructure.GPIO_Speed = GPIO_Speed_50MHz;
	GPIO_Init(TFT_CS_GPIO, &GPIO_InitStructure);

	GPIO_InitStructure.GPIO_Pin = TFT_DC_PIN;
	GPIO_Init(TFT_DC_GPIO, &GPIO_InitStructure);

	GPIO_InitStructure.GPIO_Pin = TFT_BKL_PIN;
	GPIO_Init(TFT_BKL_GPIO, &GPIO_InitStructure);

#ifdef TFT_RST_PIN
	GPIO_InitStructure.GPIO_Pin = TFT_RST_PIN;
	GPIO_Init(TFT_RST_GPIO, &GPIO_InitStructure);
#endif

	/* SPI2: 模式0(CPOL=0, CPHA=1Edge), 主模式, 8bit, 10.5MHz (APB1=42MHz/4) */
	SPI_InitTypeDef SPI_InitStructure;
	SPI_InitStructure.SPI_Direction = SPI_Direction_2Lines_FullDuplex;
	SPI_InitStructure.SPI_Mode = SPI_Mode_Master;
	SPI_InitStructure.SPI_DataSize = SPI_DataSize_8b;
	SPI_InitStructure.SPI_CPOL = SPI_CPOL_Low;
	SPI_InitStructure.SPI_CPHA = SPI_CPHA_1Edge;
	SPI_InitStructure.SPI_NSS = SPI_NSS_Soft;
	SPI_InitStructure.SPI_BaudRatePrescaler = SPI_BaudRatePrescaler_4;
	SPI_InitStructure.SPI_FirstBit = SPI_FirstBit_MSB;
	SPI_InitStructure.SPI_CRCPolynomial = 10;
	SPI_Init(TFT_SPI, &SPI_InitStructure);
	SPI_Cmd(TFT_SPI, ENABLE);

	TFT_DWT_Init();
	TFT_CS_H();
	TFT_BKL_H();

#ifdef TFT_RST_PIN
	TFT_RST_L();
	TFT_DelayMs(20);
	TFT_RST_H();
#else
	/* RST 接 NRST: 上电已随 MCU 复位, 等待稳定 */
#endif
	TFT_DelayMs(120);

	/* ILI9341 初始化序列 */
	TFT_WriteCmd(0x01);             /* SWRESET 软件复位 */
	TFT_DelayMs(120);

	TFT_WriteCmd(0x11);             /* SLPOUT 退出睡眠 */
	TFT_DelayMs(120);

	TFT_WriteCmd(0x3A);             /* PIXFMT 像素格式 */
	TFT_WriteData8(0x55);           /*   16bit/像素 */

	TFT_WriteCmd(0x36);             /* MADCTL 方向/颜色序 */
	TFT_WriteData8(TFT_MADCTL);

	TFT_WriteCmd(0x20);             /* INVOFF 关闭反色(正常显示) */

	TFT_WriteReg(0xE0, gamma_pos, sizeof(gamma_pos));   /* 正极性 Gamma */
	TFT_WriteReg(0xE1, gamma_neg, sizeof(gamma_neg));   /* 负极性 Gamma */

	TFT_WriteCmd(0x29);             /* DISPON 开显示 */
	TFT_DelayMs(20);

	TFT_FillScreen(TFT_BLACK);
}

/* ================= 绘图 ================= */

void TFT_SetWindow(uint16_t x1, uint16_t y1, uint16_t x2, uint16_t y2)
{
	TFT_WriteCmd(0x2A);             /* CASET 列地址 */
	TFT_WriteData8(x1 >> 8);
	TFT_WriteData8(x1 & 0xFF);
	TFT_WriteData8(x2 >> 8);
	TFT_WriteData8(x2 & 0xFF);

	TFT_WriteCmd(0x2B);             /* PASET 行地址 */
	TFT_WriteData8(y1 >> 8);
	TFT_WriteData8(y1 & 0xFF);
	TFT_WriteData8(y2 >> 8);
	TFT_WriteData8(y2 & 0xFF);

	TFT_WriteCmd(0x2C);             /* RAMWR 写显存 */
}

void TFT_FillColor(uint16_t color, uint32_t count)
{
	uint8_t hi = color >> 8;
	uint8_t lo = color & 0xFF;

	TFT_DC_H();
	TFT_CS_L();
	while (count--)
	{
		TFT_SPI_WriteByte(hi);
		TFT_SPI_WriteByte(lo);
	}
	TFT_CS_H();
}

/* LVGL flush 专用: 把一整块矩形区域的像素缓冲区发到屏幕.
 * 与 TFT_FillColor 不同: 每个像素颜色来自缓冲区, 非单一颜色.
 * CS 全程拉低, 发完再拉高, 避免逐像素切换 CS 导致速度极慢. */
void TFT_WritePixels(uint16_t x1, uint16_t y1, uint16_t x2, uint16_t y2,
					 const uint8_t *pixels)
{
	uint32_t count;

	TFT_SetWindow(x1, y1, x2, y2);      /* 设定窗口 */
	TFT_DC_H();                          /* 数据模式 */
	TFT_CS_L();
	count = (uint32_t)(x2 - x1 + 1) * (y2 - y1 + 1) * 2;  /* RGB565: 每像素2字节 */
	while (count--)
	{
		TFT_SPI_WriteByte(*pixels++);
	}
	TFT_CS_H();
}

void TFT_FillScreen(uint16_t color)
{
	TFT_SetWindow(0, 0, TFT_WIDTH - 1, TFT_HEIGHT - 1);
	TFT_FillColor(color, (uint32_t)TFT_WIDTH * TFT_HEIGHT);
}

void TFT_DrawPixel(uint16_t x, uint16_t y, uint16_t color)
{
	if (x >= TFT_WIDTH || y >= TFT_HEIGHT)
	{
		return;
	}
	TFT_SetWindow(x, y, x, y);
	TFT_FillColor(color, 1);
}

void TFT_DrawChar(uint16_t x, uint16_t y, char c, uint16_t fg, uint16_t bg)
{
	uint8_t idx, row, col, byte;
	uint16_t i;

	if (c < 0x20 || c > 0x7E)
	{
		c = ' ';
	}
	idx = c - 0x20;

	TFT_SetWindow(x, y, x + 7, y + 15);
	TFT_DC_H();
	TFT_CS_L();
	for (row = 0; row < 16; row++)
	{
		for (col = 0; col < 8; col++)
		{
			byte = (row < 8) ? font_F8x16[idx][col] : font_F8x16[idx][col + 8];
			i = (byte >> (row & 7)) & 0x01 ? fg : bg;
			TFT_SPI_WriteByte(i >> 8);
			TFT_SPI_WriteByte(i & 0xFF);
		}
	}
	TFT_CS_H();
}

void TFT_DrawString(uint16_t x, uint16_t y, const char *str, uint16_t fg, uint16_t bg)
{
	while (*str)
	{
		TFT_DrawChar(x, y, *str++, fg, bg);
		x += 8;
		if (x + 8 > TFT_WIDTH)
		{
			x = 0;
			y += 16;
		}
	}
}
